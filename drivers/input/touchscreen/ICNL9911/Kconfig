## drivers/input/touchscreen/ICNL9911/Kconfig
```kconfig
config TOUCHSCREEN_CTS
    bool "Cts Touchscreen"
    help
      Say Y here if you have CTS touch panel.
      If unsure, say N.
      

    
```

## drivers/kernel_modules/input/misc/sx933x/Kconfig
```kconfig
#
# Input misc drivers sx933x configuration
#

config INPUT_SX933x
	tristate "SX933x_SAR_sensor"
	depends on I2C
	default y
	help
	  Say Y to enable the SAR detection application, if N here not to use the
	  this SAR sensor
```

## drivers/misc/device_info/Kconfig
```kconfig
config OPLUS_DEVICE_IFNO
	bool "config oplus factory mode device info software"
	default y
	help
		define this config to compile device_info.c for device register
```
